## Kconfig.projbuild
```kconfig
menu "ESP32-Rotary-Encoder Configuration"

config ROT_ENC_A_GPIO
    int "Rotary Encoder A (CLK) output GPIO number"
	range 0 39
	default 4
	help
		GPIO number (IOxx) from which to sample the Rotary Encoder 'A' output.

		Some GPIOs are used for other purposes (flash connections, etc.) and cannot be used.

config ROT_ENC_B_GPIO
    int "Rotary Encoder B (DATA) output GPIO number"
	range 0 39
	default 5
	help
		GPIO number (IOxx) from which to sample the Rotary Encoder 'B' output.

		Some GPIOs are used for other purposes (flash connections, etc.) and cannot be used.

endmenu
```
